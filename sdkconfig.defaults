## sdkconfig.defaults
```kconfig
# 目标芯片 ESP32-S3，16MB Flash
CONFIG_ESPTOOLPY_FLASHSIZE_16MB=y
CONFIG_ESPTOOLPY_FLASHSIZE="16MB"

# 自定义分区：4MB 应用分区（见 partitions.csv）
CONFIG_PARTITION_TABLE_CUSTOM=y
CONFIG_PARTITION_TABLE_CUSTOM_FILENAME="partitions.csv"
CONFIG_PARTITION_TABLE_FILENAME="partitions.csv"

# LVGL：RGB565 + 默认字体
CONFIG_LV_COLOR_DEPTH_16=y
CONFIG_LV_COLOR_DEPTH=16
CONFIG_LV_FONT_MONTSERRAT_14=y
CONFIG_LV_USE_THEME_DEFAULT=y
```
